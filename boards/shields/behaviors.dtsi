/ {
    behaviors {
        debug_press: debug_press {
            compatible = "zmk,behavior-mod-morph";
            #binding-cells = <0>;
            bindings = <&none>, <&none>;
            mods = <(MOD_LSFT|MOD_RSFT)>;
            keep-mods = <(MOD_LSFT|MOD_RSFT)>;
        };
    };
};